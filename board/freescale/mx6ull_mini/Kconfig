## board/freescale/mx6ull_mini/Kconfig
```kconfig
if TARGET_MX6ULL_MINI

config SYS_BOARD
	default "mx6ull_mini"

config SYS_VENDOR
	default "freescale"

config SYS_CONFIG_NAME
	default "mx6ull_mini"

endif
```
